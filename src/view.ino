#include "view.h"

View::View() {
    display = Adafruit_SSD1306(SCREEN_WIDTH, SCREEN_HEIGHT, &Wire);
    rxRDSTextOffset = 0;
}

void View::begin() {
    while (!display.begin(SSD1306_SWITCHCAPVCC, OLED_ADDR));
}

void View::displayLogo() {
    const static unsigned char PROGMEM logoBMP[] = {
            0x00, 0x00, 0x00, 0x00, 0x00, 0x00, 0x00, 0x00, 0x00, 0x00, 0x00, 0x00, 0x00, 0x00, 0x00, 0x00,
            0x00, 0x00, 0x00, 0x00, 0x00, 0x00, 0x00, 0x00, 0x00, 0x00, 0x00, 0x00, 0x00, 0x00, 0x00, 0x00,
            0x00, 0x00, 0x00, 0x00, 0x00, 0x00, 0x00, 0x00, 0x00, 0x00, 0x00, 0x00, 0x00, 0x00, 0x00, 0x00,
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            0x00, 0x00, 0x00, 0x00, 0x00, 0x00, 0x00, 0x00, 0x00, 0x00, 0x00, 0x00, 0x00, 0x00, 0x00, 0x00,
    };

    display.clearDisplay();
    display.drawBitmap(0, 0, logoBMP, LOGO_WIDTH, LOGO_HEIGHT, WHITE);
    display.display();
    delay(1000);
}

void View::displayVol(int vol) {
    display.clearDisplay();
    display.setTextSize(2);
    display.setTextColor(WHITE);
    display.setCursor(25, 8);
    display.printf("Vol %2d", vol);
    display.display();
}

void View::displayRxFreq(int rxFreq) {
    double f = rxFreq / 10.0;
    display.clearDisplay();
    display.setTextSize(2);
    display.setTextColor(WHITE);
    display.setCursor(0, 8);
    display.printf("Rx %.1fMHz", f);
    display.display();
}

void View::displayRxRDSTextAsMarquee(const char *rdsBuff) {
    display.clearDisplay();

    display.setTextSize(2);
    display.setTextColor(WHITE);
    display.setCursor(0, 8);
    display.setTextWrap(false);

    int counterOffset = 0;
    char rdsShowBuff[OLED_TEXT_LEN_BY_ONE_LINE];
    for (int i = 0; i < OLED_TEXT_LEN_BY_ONE_LINE; i++) {
        int cursor = i + rxRDSTextOffset - counterOffset;
        if (cursor >= RDS_TEXT_LENGTH) {
            cursor -= RDS_TEXT_LENGTH;
        }
        rdsShowBuff[i] = rdsBuff[cursor];
    }

    display.print(rdsShowBuff);
    display.display();

    delay(150);

    incrementRxRDSTextOffset();
}

void View::incrementRxRDSTextOffset() {
    if (++rxRDSTextOffset >= RDS_TEXT_LENGTH) {
        rxRDSTextOffset = 0;
    }
}

void View::displayTxFreq(int txFreq) {
    double f = txFreq / 10.0;
    display.clearDisplay();
    display.setTextSize(2);
    display.setTextColor(WHITE);
    display.setCursor(0, 8);
    display.printf("Tx %.1fMHz", f);
    display.display();
}

void View::displayTxRDSTextForInput(const char *rdsBuff) {
    char *rdsShowBuff = (char *) malloc(sizeof(char) * OLED_TEXT_LEN_BY_ONE_LINE);
    if (strlen(rdsBuff) >= OLED_TEXT_LEN_BY_ONE_LINE) {
        strncpy(rdsShowBuff, &rdsBuff[strlen(rdsBuff) - (OLED_TEXT_LEN_BY_ONE_LINE - 1)],
                OLED_TEXT_LEN_BY_ONE_LINE - 1);
    } else {
        strcpy(rdsShowBuff, rdsBuff);
    }

    display.clearDisplay();
    display.setTextSize(2);
    display.setTextColor(WHITE);
    display.setCursor(0, 8);
    display.setTextWrap(false);
    display.printf(rdsShowBuff);
    display.display();

    free(rdsShowBuff);
}
